## src/examples/px4_data_subscriber/Kconfig
```kconfig
menuconfig EXAMPLES_PX4_DATA_SUBSCRIBER
    bool "px4_data_subscriber"
    default n
    ---help---
        Enable support for px4_data_subscriber example
```

## src/modules/motor_failure_detection/Kconfig
```kconfig
menuconfig MODULES_MOTOR_FAILURE_DETECTION
    bool "motor_failure_detection"
    default n
    ---help---
        Enable support for motor_failure_detection

menuconfig USER_MOTOR_FAILURE_DETECTION
    bool "motor_failure_detection running as userspace module"
    default n
    depends on BOARD_PROTECTED && MODULES_MOTOR_FAILURE_DETECTION
    ---help---
        Put motor_failure_detection in userspace memory
```

## src/modules/waypoint_test/Kconfig
```kconfig
menuconfig MODULES_WAYPOINT_TEST
    bool "waypoint_test"
    default n
    ---help---
        Enable support for waypoint_test

menuconfig USER_WAYPOINT_TEST
    bool "waypoint_test running as userspace module"
    default n
    depends on BOARD_PROTECTED && MODULES_WAYPOINT_TEST
    ---help---
        Put waypoint_test in userspace memory
```
